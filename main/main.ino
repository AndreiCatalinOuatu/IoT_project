#include <Adafruit_Fingerprint.h>
#include <HardwareSerial.h>
#include <Adafruit_GFX.h> 
#include <Adafruit_SSD1306.h>
#include <SPI.h>
#include <Wire.h>
#include <WiFi.h>
#include <HTTPClient.h>
#include "time.h"

#define SCREEN_WIDTH 128
#define SCREEN_HEIGHT 64
#define OLED_RESET -1

Adafruit_SSD1306 display(SCREEN_WIDTH, SCREEN_HEIGHT, &Wire, OLED_RESET);
HardwareSerial mySerial(2);
Adafruit_Fingerprint fingerprint = Adafruit_Fingerprint(&mySerial);

int buzzerPin = 29;

#define LOGO_HEIGHT   64
#define LOGO_WIDTH    128
static const unsigned char PROGMEM logo_bmp[] =
{
  0x00, 0x00, 0x00, 0x00, 0x00, 0x00, 0x00, 0x00, 0x00, 0x00, 0x00, 0x00, 0x00, 0x00, 0x00, 0x00,
  0x00, 0x00, 0x00, 0x00, 0x00, 0x00, 0x00, 0x00, 0x00, 0x00, 0x00, 0x00, 0x00, 0x00, 0x00, 0x00,
  0x00, 0x00, 0x00, 0x00, 0x00, 0x00, 0x03, 0xff, 0xc0, 0x00, 0x00, 0x00, 0x00, 0x00, 0x00, 0x00,
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  0x00, 0x00, 0x00, 0x00, 0x00, 0x00, 0x00, 0x00, 0x00, 0x00, 0x00, 0x00, 0x00, 0x00, 0x00, 0x00
};

const char* SSID = "DIGI-N6Me";
const char* password = "5hMuJz29";

String GOOGLE_SCRIPT_ID = "AKfycbw73GOjilnd_u9uKRQCVzJnCZCsgmN9mlLSJNvaN2RRvr8ua8t-WyuMBLbo1jFA8lRJ2Q";

const char* ntpServer = "pool.ntp.org";
const long gmtOffset_sec = 10800;
const int daylightOffset_sec = 0;

const char* coming = "In";
const char* leaving = "Out";

void setup() {
  // put your setup code here, to run once:
  pinMode(buzzerPin, OUTPUT);
  delay(1000);
  mySerial.begin(57600);
  Serial.begin(115200);

  Serial.print("Connecting to WiFi: ");
  Serial.println(SSID);

  WiFi.begin(SSID, password);

  while (WiFi.status() != WL_CONNECTED) {
    delay(500);
    Serial.print(".");
  }

  if (!display.begin(SSD1306_SWITCHCAPVCC, 0x3C)) {
    Serial.println(F("SSD1306  allocation failed"));
    while(1);
  }

  while (!Serial);
  delay(100);

  display.clearDisplay();
  display.drawBitmap(0, 0, logo_bmp, LOGO_WIDTH, LOGO_HEIGHT, 1);
  display.display();

  delay(3000);

  Serial.println("Biometric Attendance System");
  delay(3000);
  display.clearDisplay();

  fingerprint.begin(57600);

  if (fingerprint.verifyPassword()) {
    Serial.println("Fingerprint Sensor Connected");
    display.clearDisplay();
    display.setTextSize(2);
    display.setTextColor(SSD1306_WHITE);
    display.setCursor(25, 0);
    display.println(("Sensor"));
    display.setCursor(5, 35);
    display.println(("Connected"));
    display.display();
    delay(3000);
    Serial.println("Fingerprint Sensor Connected");
  } else {
    display.clearDisplay();
    display.setTextSize(2);            
    display.setTextColor(SSD1306_WHITE);       
    display.setCursor(25, 0);            
    display.println(("Sensor"));
    display.setCursor(5, 35);
    display.println("Not Found");
    display.display();
   
    Serial.println("Unable to find Sensor");
    delay(3000);
    Serial.println("Check Connections");
 
    while (1) {
      delay(1);    
    }
  }
  display.clearDisplay();

  configTime(gmtOffset_sec, daylightOffset_sec, ntpServer);
}

void loop() {
  // put your main code here, to run repeatedly:
  getFingerprintID();
  delay(1000);
}


uint8_t getFingerprintID() {
  uint8_t p = fingerprint.getImage();
  switch (p) {
    case FINGERPRINT_OK:
      Serial.println("Image taken");
      break;
    case FINGERPRINT_NOFINGER:
      //Serial.println("No finger detected");
      return p;
    case FINGERPRINT_PACKETRECIEVEERR:
      Serial.println("Communication error");
      return p;
    case FINGERPRINT_IMAGEFAIL:
      Serial.println("Imaging error");
      return p;
    default:
      Serial.println("Unknown error");
      return p;
  }

  p = fingerprint.image2Tz();
  switch (p) {
    case FINGERPRINT_OK:
      Serial.println("Image converted");
      break;
    case FINGERPRINT_IMAGEMESS:
      Serial.println("Image too messy");
      return p;
    case FINGERPRINT_PACKETRECIEVEERR:
      Serial.println("Communication error");
      return p;
    case FINGERPRINT_FEATUREFAIL:
      Serial.println("Could not find fingerprint features");
      return p;
    case FINGERPRINT_INVALIDIMAGE:
      Serial.println("Could not find fingerprint features");
      return p;
    default:
      Serial.println("Unknown error");
      return p;
  }

  p = fingerprint.fingerSearch();
  if (p == FINGERPRINT_OK) {
    Serial.println("Found a print match!");
      if (WiFi.status() == WL_CONNECTED) {
        struct tm timeinfo;
        if (!getLocalTime(&timeinfo)) {
          Serial.println("Failed to obtain local timestamp");
          return -15;
        }
        char timeStringBuff[50];
        strftime(timeStringBuff, 50, "%A, %B %d %Y %H:%M:%S", &timeinfo);
        String tmfasString(timeStringBuff);
        tmfasString.replace(" ", "-");
        delay(1000);
        Serial.println("Enter if you are coming or you are leaving. 2 Options: In or Out");
        String s = Serial.readStringUntil('\n');
        s.trim();
        delay(1000);
        Serial.println(s);
        delay(5000);
        if (s.equals("In") || s.equals("Out")) {
          String url_final = "https://script.google.com/macros/s/"+GOOGLE_SCRIPT_ID+"/exec?"+"Name="+ fingerprint.fingerID + "&Timestamp=" + tmfasString + "&InOrOut=" + s;
          HTTPClient http;
          http.begin(url_final.c_str());
          http.setFollowRedirects(HTTPC_STRICT_FOLLOW_REDIRECTS);
          int httpCode = http.GET();
          Serial.print("The status code is: ");
          Serial.println(httpCode);
          http.end();
          if (httpCode == 200) {
            display.clearDisplay();
            display.setTextSize(2);
            display.setTextColor(SSD1306_WHITE);
            display.setCursor(25, 0);
            display.println(("Attendance"));
            display.setCursor(5, 35);
            display.println(("Added"));
            display.display();
            delay(5000);
          }
        } else {
          display.clearDisplay();
          display.setTextSize(2);
          display.setTextColor(SSD1306_WHITE);
          display.setCursor(25, 0);
          display.println(("Try"));
          display.setCursor(5, 35);
          display.println(("Again"));
          display.display();
          delay(5000);
        }
      }
  } else if (p == FINGERPRINT_PACKETRECIEVEERR) {
    Serial.println("Communication error");
    return p;
  } else if (p == FINGERPRINT_NOTFOUND) {
    Serial.println("Did not find a match");
    pinMode(buzzerPin, HIGH);
    display.clearDisplay();
    display.setTextSize(2);
    display.setTextColor(SSD1306_WHITE);
    display.setCursor(25, 0);
    display.println(("Finger"));
    display.setCursor(5, 35);
    display.println(("Not valid"));
    display.display();
    delay(2000);
    display.clearDisplay();
    display.setTextSize(2);
    display.setTextColor(SSD1306_WHITE);
    display.setCursor(25, 0);
    display.println(("Try"));
    display.setCursor(5, 35);
    display.println(("Again"));
    display.display();
    delay(2000);
    pinMode(buzzerPin, LOW);
    return p;
  } else {
    Serial.println("Unknown error");
    return p;
  }

  return fingerprint.fingerID;
}